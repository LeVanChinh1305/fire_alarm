## sdkconfig.defaults
```kconfig
# Console
CONFIG_ESP_CONSOLE_USB_SERIAL_JTAG=y
CONFIG_ESP_CONSOLE_UART_DEFAULT=n

# ==================== Bluetooth ====================
CONFIG_BT_ENABLED=y
CONFIG_BT_BLUEDROID_ENABLED=y
CONFIG_BT_CONTROLLER_ENABLED=y
CONFIG_BT_BLE_ENABLED=y

# Bluedroid Options
CONFIG_BT_GATTS_ENABLE=y
CONFIG_BT_GATTC_ENABLE=y
CONFIG_BT_BLE_42_FEATURES_SUPPORTED=y
CONFIG_BT_BLE_SMP_ENABLE=y

# ==================== BLE Mesh ====================
CONFIG_BLE_MESH=y
CONFIG_BLE_MESH_BLUEDROID_HOST=y
CONFIG_BLE_MESH_NODE=y
CONFIG_BLE_MESH_PROV=y
CONFIG_BLE_MESH_CFG_SRV=y
CONFIG_BLE_MESH_GATT_PROXY_SERVER=y
CONFIG_BLE_MESH_RELAY=n
CONFIG_BLE_MESH_FRIEND=n
CONFIG_BLE_MESH_LOW_POWER=n
CONFIG_BLE_MESH_PB_GATT=y

# Server models
CONFIG_BLE_MESH_GENERIC_SERVER=y
CONFIG_BLE_MESH_LIGHTING_SERVER=y
CONFIG_BLE_MESH_HEALTH_SRV=y

# Health Client (dùng trong element 0)
CONFIG_BLE_MESH_HEALTH_CLI=y

# Model key/group slots (3 AppKey HOMI, 3 group address)
CONFIG_BLE_MESH_MODEL_KEY_COUNT=3
CONFIG_BLE_MESH_MODEL_GROUP_COUNT=3

# Tắt Client models không dùng (không có client model trong code)
# CONFIG_BLE_MESH_CFG_CLI is not set
# CONFIG_BLE_MESH_GENERIC_ONOFF_CLI is not set
# CONFIG_BLE_MESH_GENERIC_LEVEL_CLI is not set
# CONFIG_BLE_MESH_GENERIC_DEF_TRANS_TIME_CLI is not set
# CONFIG_BLE_MESH_GENERIC_POWER_ONOFF_CLI is not set
# CONFIG_BLE_MESH_LIGHT_LIGHTNESS_CLI is not set
# CONFIG_BLE_MESH_LIGHT_CTL_CLI is not set
```
